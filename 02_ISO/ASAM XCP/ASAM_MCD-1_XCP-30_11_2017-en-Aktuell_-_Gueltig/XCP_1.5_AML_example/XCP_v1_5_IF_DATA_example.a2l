/* ASAP2 example for XCP IF_DATA V1.5 */
/begin IF_DATA XCPplus 0x0105 /* IF_DATA XCP version */
 /begin PROTOCOL_LAYER 0x0105 0x0019 0x0019 0x0019 0x0019 0x0019 0x0005 0x00C8 0x20 0x00FF /* MAX_DTO */ BYTE_ORDER_MSB_FIRST ADDRESS_GRANULARITY_WORD SEED_AND_KEY_EXTERNAL_FUNCTION "MyS&K.DLL" OPTIONAL_CMD GET_ID OPTIONAL_CMD SET_REQUEST OPTIONAL_CMD GET_SEED OPTIONAL_CMD UNLOCK OPTIONAL_CMD SET_MTA OPTIONAL_CMD UPLOAD OPTIONAL_CMD BUILD_CHECKSUM OPTIONAL_CMD DOWNLOAD OPTIONAL_CMD SET_CAL_PAGE OPTIONAL_CMD GET_CAL_PAGE OPTIONAL_CMD COPY_CAL_PAGE OPTIONAL_CMD CLEAR_DAQ_LIST OPTIONAL_CMD SET_DAQ_PTR OPTIONAL_CMD WRITE_DAQ OPTIONAL_CMD SET_DAQ_LIST_MODE OPTIONAL_CMD START_STOP_DAQ_LIST OPTIONAL_CMD START_STOP_SYNCH OPTIONAL_CMD GET_DAQ_CLOCK OPTIONAL_CMD WRITE_DAQ_MULTIPLE OPTIONAL_CMD DTO_CTR_PROPERTIES OPTIONAL_CMD TIME_CORRELATION_PROPERTIES
  /begin ECU_STATES
   /begin STATE 1 /* STATE_NUMBER */ "ECU_ON" /* STATE_NAME */ ACTIVE /* CAL/PAG RESOURCE */ ACTIVE /* DAQ RESOURCE */ NOT_ACTIVE /* STIM RESOURCE */ ACTIVE /* PGM RESOURCE */ /begin MEMORY_ACCESS 0 0 READ_ACCESS_ALLOWED WRITE_ACCESS_ALLOWED /end MEMORY_ACCESS /begin MEMORY_ACCESS 0 1 READ_ACCESS_ALLOWED WRITE_ACCESS_ALLOWED /end MEMORY_ACCESS /end STATE
   /begin STATE 2 /* STATE_NUMBER */ "ECU_IN_SAFE_MODE" /* STATE_NAME */ ECU_SWITCHED_TO_DEFAULT_PAGE /* Switch to default page -> safe mode */ GETTER_ONLY /* CAL/PAG RESOURCE */ NOT_ACTIVE /* DAQ RESOURCE */ NOT_ACTIVE /* STIM RESOURCE */ NOT_ACTIVE /* PGM RESOURCE */ /begin MEMORY_ACCESS 0 0 READ_ACCESS_ALLOWED WRITE_ACCESS_NOT_ALLOWED /end MEMORY_ACCESS /begin MEMORY_ACCESS 0 1 READ_ACCESS_ALLOWED WRITE_ACCESS_NOT_ALLOWED /end MEMORY_ACCESS /end STATE
  /end ECU_STATES
 /end PROTOCOL_LAYER
 /begin DAQ DYNAMIC 0x100 0x100 0x05 OPTIMISATION_TYPE_ODT_TYPE_32 ADDRESS_EXTENSION_FREE IDENTIFICATION_FIELD_TYPE_RELATIVE_WORD_ALIGNED GRANULARITY_ODT_ENTRY_SIZE_DAQ_WORD 0x04 NO_OVERLOAD_INDICATION PRESCALER_SUPPORTED RESUME_SUPPORTED
  /begin STIM GRANULARITY_ODT_ENTRY_SIZE_STIM_WORD 0x04 /* MAX_ODT_ENTRY_SIZE_STIM */ BIT_STIM_SUPPORTED /end STIM
  /begin TIMESTAMP_SUPPORTED 0x000A SIZE_WORD UNIT_1US TIMESTAMP_FIXED /end TIMESTAMP_SUPPORTED
  /begin EVENT "10_ms_task" "10 ms" 0x0000 DAQ_STIM 0x02 0x0A 0x06 0x00 /end EVENT
  /begin EVENT "100_ms_task" "100 ms" 0x0001 DAQ_STIM 0x02 0x64 0x06 0x10 CONSISTENCY EVENT
   /begin CPU_LOAD_CONSUMPTION_DAQ 1 2 3 /begin ODT_ENTRY_SIZE_FACTOR_TABLE 1 150 /* SIZE_FACTOR: e.g. CPU cycles */ /end ODT_ENTRY_SIZE_FACTOR_TABLE /begin ODT_ENTRY_SIZE_FACTOR_TABLE 4 420 /end ODT_ENTRY_SIZE_FACTOR_TABLE /end CPU_LOAD_CONSUMPTION_DAQ
  /end EVENT
  /begin EVENT "Bypass_DAQ" "BYP_DAQ" 0x0002 DAQ 0x02 0x0A 0x06 0xFF CONSISTENCY EVENT EVENT_COUNTER_PRESENT RELATED_EVENT_CHANNEL_NUMBER 0x0002 RELATED_EVENT_CHANNEL_NUMBER_FIXED DTO_CTR_DAQ_MODE INSERT_COUNTER DTO_CTR_DAQ_MODE_FIXED /end EVENT
  /begin EVENT "Bypass_STIM" "BYP_STIM" 0x0003 STIM 0x02 0x0A 0x06 0x00 RELATED_EVENT_CHANNEL_NUMBER 0x0002 RELATED_EVENT_CHANNEL_NUMBER_FIXED DTO_CTR_STIM_MODE CHECK_COUNTER DTO_CTR_STIM_MODE_FIXED /end EVENT
  /begin EVENT "Highspeed_10us" "HS_10us" 0x0004 DAQ 0x01 0x01 0x04 /* EVENT_CHANNEL_TIME_UNIT - 10 micro s */ 0x00
   /begin DAQ_PACKED_MODE ELEMENT_GROUPED /* --> DAQ_PACKED_MODE */ STS_LAST /* --> DPM_TIMESTAMP_MODE */ OPTIONAL 10 /* --> DPM_SAMPLE_COUNT */ ALT_SAMPLE_COUNT 20 /end DAQ_PACKED_MODE
  /end EVENT
 /end DAQ
 /begin PAG 0x01 /* MAX_SEGMENTS */ FREEZE_SUPPORTED /end PAG
 /begin PGM PGM_MODE_ABSOLUTE_AND_FUNCTIONAL 0x02 /* MAX_SECTORS */ 0x08 /* MAX_CTO_PGM */
  /begin SECTOR "Lower sector" 0x00 /* SECTOR_NUMBER */ 0x000000 /* address */ 0x20000 /* length */ 0x01 /* Erase number */ 0x02 /* Program number */ 0x00 /* Programming method */ /end SECTOR
  /begin SECTOR "Upper sector" 0x01 /* SECTOR_NUMBER */ 0x020000 /* address */ 0x20000 /* length */ 0x03 /* Erase number */ 0x04 /* Program number */ 0x00 /* Programming method */ /end SECTOR
 /end PGM
 /begin TIME_CORRELATION DAQ_TIMESTAMPS_RELATE_TO XCP_SLAVE_CLOCK /* DAQ/STIM timestamps */ /* related to XCP_SLAVE_CLOCK */ /* configuration relates to scenario 1 */
  /begin CLOCK 0x00 0x16 0x81 0xFF 0xFE 0x01 0x02 0x03 XCP_SLAVE_CLOCK RANDOMLY_READABLE SYN_UNSUPPORTED 0xFF /begin TIMESTAMP_CHARACTERIZATION 0x01 UNIT_1US SIZE_FOUR_BYTE /end TIMESTAMP_CHARACTERIZATION 0x00000000FFFFFFFF ARBITRARY /end CLOCK
  /* configuration relates to scenario 2 */
  /begin CLOCK 0x00 0x16 0x81 0xFF 0xFE 0x01 0x02 0x03 XCP_SLAVE_CLOCK RANDOMLY_READABLE SYN_ALL /* Once the clock is synchronized or syntonized */ /* the characteristics of the grandmaster clock */ /* shall be made available to the master by the */ 0xFF /begin TIMESTAMP_CHARACTERIZATION 0x01 UNIT_1NS SIZE_EIGHT_BYTE /end TIMESTAMP_CHARACTERIZATION 0xFFFFFFFFFFFFFFFF ARBITRARY /end CLOCK
  /* configuration relates to scenario 4a */
  /begin CLOCK 0x00 0x16 0x81 0xFF 0xFE 0x01 0x02 0x03 XCP_SLAVE_CLOCK RANDOMLY_READABLE SYN_UNSUPPORTED 0xFF /begin TIMESTAMP_CHARACTERIZATION 0x01 UNIT_1US SIZE_FOUR_BYTE /end TIMESTAMP_CHARACTERIZATION 0x00000000FFFFFFFF ARBITRARY /end CLOCK
  /begin CLOCK 0x00 0x00 0x00 0x00 0x00 0x00 0x00 0x00 XCP_SLAVE_GRANDMASTER_CLOCK RANDOMLY_READABLE SYN_ALL 0xFF /begin TIMESTAMP_CHARACTERIZATION 0x01 UNIT_1NS SIZE_EIGHT_BYTE /end TIMESTAMP_CHARACTERIZATION 0xFFFFFFFFFFFFFFFF ARBITRARY /end CLOCK
  /* configuration relates to scenario 4b */
  /begin CLOCK 0x00 0x16 0x81 0xFF 0xFE 0x01 0x02 0x03 XCP_SLAVE_CLOCK RANDOMLY_READABLE SYN_UNSUPPORTED 0xFF /begin TIMESTAMP_CHARACTERIZATION 0x01 UNIT_1US SIZE_FOUR_BYTE /end TIMESTAMP_CHARACTERIZATION 0x00000000FFFFFFFF ARBITRARY /end CLOCK
  /begin CLOCK 0x00 0x00 0x00 0x00 0x00 0x00 0x00 0x00 XCP_SLAVE_GRANDMASTER_CLOCK LIMITED_READABLE SYN_ALL 0xFF /begin TIMESTAMP_CHARACTERIZATION 0x01 UNIT_1NS SIZE_EIGHT_BYTE /end TIMESTAMP_CHARACTERIZATION 0xFFFFFFFFFFFFFFFF ARBITRARY /end CLOCK
  /* configuration relates to scenario 5 */
  /begin CLOCK 0x00 0x16 0x81 0xFF 0xFE 0x01 0x02 0x03 XCP_SLAVE_CLOCK RANDOMLY_READABLE SYN_UNSUPPORTED 0xFF /begin TIMESTAMP_CHARACTERIZATION 0x01 UNIT_1US SIZE_FOUR_BYTE /end TIMESTAMP_CHARACTERIZATION 0x00000000FFFFFFFF ARBITRARY /end CLOCK
  /begin CLOCK 0x00 0x00 0x00 0x00 0x04 0x03 0x02 0x01 ECU_CLOCK LIMITED_READABLE SYN_UNSUPPORTED 0xFF /begin TIMESTAMP_CHARACTERIZATION 0x0A UNIT_1US SIZE_FOUR_BYTE /end TIMESTAMP_CHARACTERIZATION 0x00000000FFFFFFFF ARBITRARY /end CLOCK
  /* configuration relates to scenario 6 */
  /begin CLOCK 0x00 0x16 0x81 0xFF 0xFE 0x01 0x02 0x03 XCP_SLAVE_CLOCK RANDOMLY_READABLE SYN_UNSUPPORTED 0xFF /begin TIMESTAMP_CHARACTERIZATION 0x01 UNIT_1US SIZE_FOUR_BYTE /end TIMESTAMP_CHARACTERIZATION 0x00000000FFFFFFFF ARBITRARY /end CLOCK
  /begin CLOCK 0x00 0x00 0x00 0x00 0x00 0x00 0x00 0x00 XCP_SLAVE_GRANDMASTER_CLOCK LIMITED_READABLE SYN_ALL 0xFF /begin TIMESTAMP_CHARACTERIZATION 0x01 UNIT_1NS SIZE_EIGHT_BYTE /end TIMESTAMP_CHARACTERIZATION 0xFFFFFFFFFFFFFFFF ARBITRARY /end CLOCK
  /begin CLOCK 0x00 0x00 0x00 0x00 0x04 0x03 0x02 0x01 ECU_CLOCK LIMITED_READABLE SYN_UNSUPPORTED 0xFF /begin TIMESTAMP_CHARACTERIZATION 0x0A UNIT_1US SIZE_FOUR_BYTE /end TIMESTAMP_CHARACTERIZATION 0x00000000FFFFFFFF ARBITRARY /end CLOCK
  /* configuration relates to scenario 7 */
  /begin CLOCK 0x00 0x00 0x00 0x00 0x04 0x03 0x02 0x01 ECU_CLOCK NOT_READABLE SYNCHRONIZATION_ONLY /* Clock only supports synchronization to */ /* external grandmaster clock. */ /* The characteristics of the grandmaster clock */ /* shall be made available to the master by the */ /* ECU_GRANDM_CLK_INFO structure. */ 0xFF /begin TIMESTAMP_CHARACTERIZATION 0x0A UNIT_1US SIZE_FOUR_BYTE /end TIMESTAMP_CHARACTERIZATION 0x00000000FFFFFFFF ARBITRARY /end CLOCK
 /end TIME_CORRELATION
 /begin XCP_ON_TCP_IP 0x0105 /* XCP on TCP_IP version */ 0x5555 /* PORT */ /* IPV6 ADDRESS */ IPV6 "FE80:0000:0000:0000:0202:B3FF:FE1E:8329" MAX_BUS_LOAD 15 /* MAX_BUS_LOAD */ MAX_BIT_RATE 100 /end XCP_ON_TCP_IP
 /begin XCP_ON_UDP_IP 0x0105 /* XCP on UDP_IP version */ 0x5555 /* PORT */ ADDRESS "127.0.0.1" /* ADDRESS */ MAX_BUS_LOAD 80 /* MAX_BUS_LOAD */ MAX_BIT_RATE 10 /end XCP_ON_UDP_IP
 /begin XCP_ON_CAN 0x0105 CAN_ID_BROADCAST 0x100 /* Broadcast */ CAN_ID_MASTER 0x200 CAN_ID_MASTER_INCREMENTAL CAN_ID_SLAVE 0x300 BAUDRATE 500000 /begin DAQ_LIST_CAN_ID 0x0000 /* for DAQ_LIST 0 */ FIXED 0x310 /end DAQ_LIST_CAN_ID /begin DAQ_LIST_CAN_ID 0x0001 /* for DAQ_LIST 1 */ FIXED 0x320 /end DAQ_LIST_CAN_ID /begin DAQ_LIST_CAN_ID 0x0002 /* for DAQ_LIST 2 */ FIXED 0x330 /end DAQ_LIST_CAN_ID MAX_BUS_LOAD 30 /* maximum available bus load in percent */
  /begin PROTOCOL_LAYER 0x0105 0x000A 0x000A 0x000A 0x000A 0x000A 0x0000 0x0020 0x08 0x0008 /* MAX_DTO */ BYTE_ORDER_MSB_FIRST ADDRESS_GRANULARITY_BYTE OPTIONAL_CMD GET_ID OPTIONAL_CMD SET_REQUEST OPTIONAL_CMD SET_MTA OPTIONAL_CMD UPLOAD OPTIONAL_CMD BUILD_CHECKSUM OPTIONAL_CMD DOWNLOAD OPTIONAL_CMD SET_CAL_PAGE OPTIONAL_CMD GET_CAL_PAGE OPTIONAL_CMD COPY_CAL_PAGE OPTIONAL_CMD CLEAR_DAQ_LIST OPTIONAL_CMD SET_DAQ_PTR OPTIONAL_CMD WRITE_DAQ OPTIONAL_CMD SET_DAQ_LIST_MODE OPTIONAL_CMD START_STOP_DAQ_LIST OPTIONAL_CMD START_STOP_SYNCH OPTIONAL_CMD GET_DAQ_CLOCK OPTIONAL_CMD WRITE_DAQ_MULTIPLE OPTIONAL_CMD SHORT_UPLOAD OPTIONAL_CMD SHORT_DOWNLOAD OPTIONAL_CMD DOWNLOAD_NEXT COMMUNICATION_MODE_SUPPORTED BLOCK SLAVE MASTER 0x0A 0x02 /end PROTOCOL_LAYER
  /begin DAQ STATIC 0x0003 0x0002 0x01 OPTIMISATION_TYPE_DEFAULT ADDRESS_EXTENSION_DAQ IDENTIFICATION_FIELD_TYPE_ABSOLUTE GRANULARITY_ODT_ENTRY_SIZE_DAQ_BYTE 0x02 OVERLOAD_INDICATION_EVENT PRESCALER_SUPPORTED RESUME_SUPPORTED
   /begin DAQ_LIST 0x0000 DAQ_LIST_TYPE DAQ MAX_ODT 0x01 MAX_ODT_ENTRIES 0x02
    /begin PREDEFINED
     /begin ODT 0 ODT_ENTRY 0 0x4000 0x00 0x01 0xFF ODT_ENTRY 1 0x4001 0x00 0x01 0xFF /end ODT
    /end PREDEFINED
   /end DAQ_LIST
   /begin DAQ_LIST 0x0001 DAQ_LIST_TYPE DAQ_STIM MAX_ODT 0x03 MAX_ODT_ENTRIES 0x10 /end DAQ_LIST
   /begin DAQ_LIST 0x0002 DAQ_LIST_TYPE DAQ_STIM MAX_ODT 0x10 MAX_ODT_ENTRIES 0x20 /end DAQ_LIST
   /begin EVENT "10_ms_task" "10 ms" 0x0000 DAQ_STIM 0x02 0x0A 0x06 0x00 /end EVENT
   /begin EVENT "100_ms_task" "100 ms" 0x0001 DAQ_STIM 0x02 0x64 0x06 0x10 /end EVENT
  /end DAQ
  TRANSPORT_LAYER_INSTANCE "private CAN" /end XCP_ON_CAN
 /begin XCP_ON_CAN 0x0105 CAN_ID_BROADCAST 0x100 /* Broadcast */ CAN_ID_MASTER 0x7FD CAN_ID_SLAVE 0x7FE BAUDRATE 1000000 SAMPLE_POINT 85 /* sample point */ /* [% complete bit time] */ BTL_CYCLES 20 /* BTL_CYCLES */ /* [slots per bit time] */ SJW 3 /* length synchr. segment */ /* [BTL_CYCLES] */ MAX_BUS_LOAD 88 /* maximum available bus load in percent */ MEASUREMENT_SPLIT_ALLOWED /* Supports splitting of measurements to increase payload */
  /begin PROTOCOL_LAYER 0x0105 0x00FA 0x00FA 0x0000 0x0000 0x0000 0x0000 0x0000 0x08 0x0008 /* MAX_DTO default for DAQ and STIM */ BYTE_ORDER_MSB_FIRST ADDRESS_GRANULARITY_BYTE OPTIONAL_CMD GET_COMM_MODE_INFO OPTIONAL_CMD SET_MTA OPTIONAL_CMD UPLOAD OPTIONAL_CMD SHORT_UPLOAD OPTIONAL_CMD BUILD_CHECKSUM OPTIONAL_CMD DOWNLOAD OPTIONAL_CMD DOWNLOAD_NEXT OPTIONAL_CMD SET_CAL_PAGE OPTIONAL_CMD GET_CAL_PAGE OPTIONAL_CMD COPY_CAL_PAGE OPTIONAL_CMD CLEAR_DAQ_LIST OPTIONAL_CMD SET_DAQ_PTR OPTIONAL_CMD WRITE_DAQ OPTIONAL_CMD SET_DAQ_LIST_MODE OPTIONAL_CMD GET_DAQ_LIST_MODE OPTIONAL_CMD START_STOP_DAQ_LIST OPTIONAL_CMD START_STOP_SYNCH OPTIONAL_CMD FREE_DAQ OPTIONAL_CMD ALLOC_DAQ OPTIONAL_CMD ALLOC_ODT OPTIONAL_CMD ALLOC_ODT_ENTRY COMMUNICATION_MODE_SUPPORTED BLOCK SLAVE /* Slave Block Mode supported */ MASTER /* Master Block Mode supported */ 0x2B /* MAX_BS */ 0x02 /* MIN_ST */ /end PROTOCOL_LAYER
  /begin DAQ DYNAMIC 0xFFFF 0x0003 0x00 OPTIMISATION_TYPE_DEFAULT ADDRESS_EXTENSION_FREE IDENTIFICATION_FIELD_TYPE_ABSOLUTE GRANULARITY_ODT_ENTRY_SIZE_DAQ_BYTE 0x04 OVERLOAD_INDICATION_EVENT CORE_LOAD_MAX_TOTAL 0.08 /begin CORE_LOAD_MAX 1 0.06 /end CORE_LOAD_MAX /begin CORE_LOAD_MAX 2 0.05 /end CORE_LOAD_MAX /begin CORE_LOAD_MAX 3 0.0025 /end CORE_LOAD_MAX
   /begin DAQ_MEMORY_CONSUMPTION 0x000032c5 /* DAQ_MEMORY_LIMIT: in Elements[AG] */ 0x0030 /* DAQ_SIZE: number of elements[AG] per DAQ list */ 0x0010 /* ODT_SIZE: number of elements[AG] per ODT */ 0x0005 /* ODT_ENTRY_SIZE: number of elements[AG] per ODT_entry */ 0x0001 /* ODT_DAQ_BUFFER_ELEMENT_SIZE: number of */ /* payload elements[AG]*factor = sizeof(send buffer)[AG] */ 0x0002 /* ODT_STIM_BUFFER_ELEMENT_SIZE: number of */ /* payload elements[AG]*factor = sizeof(receive buffer)[AG] */
    /begin BUFFER_RESERVE 20 /* ODT_DAQ_BUFFER_ELEMENT_RESERVE in % of */ /* ODT_DAQ_BUFFER_ELEMENT_SIZE */ 40 /* ODT_STIM_BUFFER_ELEMENT_RESERVE in % of */ /* ODT_STIM_BUFFER_ELEMENT_SIZE */ /end BUFFER_RESERVE
   /end DAQ_MEMORY_CONSUMPTION
   /begin EVENT "segment synchronous" "ssyn" 0 DAQ 1 0 6 7 CONSISTENCY NONE /begin MIN_CYCLE_TIME 2 6 /end MIN_CYCLE_TIME
    /begin BUFFER_RESERVE_EVENT 30 /* ODT_DAQ_BUFFER_ELEMENT_RESERVE in % of */ /* ODT_DAQ_BUFFER_ELEMENT_SIZE */ 60 /* ODT_STIM_BUFFER_ELEMENT_RESERVE in % of */ /* ODT_STIM_BUFFER_ELEMENT_SIZE */ /end BUFFER_RESERVE_EVENT
    /begin CPU_LOAD_CONSUMPTION_DAQ 1E-6 1E-6 300E-9 /begin ODT_ENTRY_SIZE_FACTOR_TABLE 1 150E-9 /end ODT_ENTRY_SIZE_FACTOR_TABLE /begin CORE_LOAD_EP 1 0.025 /end CORE_LOAD_EP /end CPU_LOAD_CONSUMPTION_DAQ
    /begin CPU_LOAD_CONSUMPTION_QUEUE 5E-6 300E-9 /* ODT_ELEMENT_LOAD: length in elements[AG] */ /begin CORE_LOAD_EP 1 0.025 /end CORE_LOAD_EP /end CPU_LOAD_CONSUMPTION_QUEUE
   /end EVENT
   /begin EVENT "10ms time synchronous" "10ms" 1 DAQ 1 10 6 6
    /begin CPU_LOAD_CONSUMPTION_DAQ 1E-6 1E-6 300E-9 /begin ODT_ENTRY_SIZE_FACTOR_TABLE 1 150E-9 /end ODT_ENTRY_SIZE_FACTOR_TABLE /begin CORE_LOAD_EP 2 0.025 /end CORE_LOAD_EP /end CPU_LOAD_CONSUMPTION_DAQ
    /begin CPU_LOAD_CONSUMPTION_QUEUE 5E-6 300E-9 /* ODT_ELEMENT_LOAD ,length in elements[AG] */ /begin CORE_LOAD_EP 2 0.025 /end CORE_LOAD_EP /end CPU_LOAD_CONSUMPTION_QUEUE
   /end EVENT
   /begin EVENT "100ms time synchronous" "100ms" 2 DAQ /* EVENT_CHANNEL_TYPE */ 1 100 6 5
    /begin CPU_LOAD_CONSUMPTION_DAQ 1E-6 1E-6 300E-9 /begin ODT_ENTRY_SIZE_FACTOR_TABLE 1 150E-9 /end ODT_ENTRY_SIZE_FACTOR_TABLE /begin CORE_LOAD_EP 3 0.0025 /end CORE_LOAD_EP /end CPU_LOAD_CONSUMPTION_DAQ
    /begin CPU_LOAD_CONSUMPTION_QUEUE 5E-6 300E-9 /* ODT_ELEMENT_LOAD ,length in elements[AG] */ /begin CORE_LOAD_EP 3 0.0025 /end CORE_LOAD_EP /end CPU_LOAD_CONSUMPTION_QUEUE
   /end EVENT
  /end DAQ
  TRANSPORT_LAYER_INSTANCE "Calibration CAN (APPL)" /end XCP_ON_CAN
 /begin XCP_ON_CAN 0x0105 CAN_ID_BROADCAST 0x100 /* auto-detection */ CAN_ID_MASTER 0x400 CAN_ID_SLAVE 0x500 BAUDRATE 500000 OPTIONAL_TL_SUBCMD GET_SLAVE_ID OPTIONAL_TL_SUBCMD GET_DAQ_ID OPTIONAL_TL_SUBCMD SET_DAQ_ID OPTIONAL_TL_SUBCMD GET_DAQ_CLOCK_MULTICAST TRANSPORT_LAYER_INSTANCE "vehicle CAN" /end XCP_ON_CAN
 /begin XCP_ON_FLX 0x0105 /* XCP on FlexRay version */ 0x0019 /* T1_FLX [ms] */ "MyFlexRayNetwork.xml" /* FIBEX-file including CHI information */ "MyCluster" /* Cluster-ID */ 0x02 /* NAX */ HEADER_NAX_CTR_LEN PACKET_ALIGNMENT_8
  /begin INITIAL_CMD_BUFFER 0x01 MAX_FLX_LEN_BUF FIXED 32
   /begin LPDU_ID FLX_SLOT_ID FIXED 0x07B OFFSET FIXED 0 CYCLE_REPETITION FIXED 1 CHANNEL FIXED A /end LPDU_ID
   /begin XCP_PACKET CMD FIXED RES_ERR NOT_ALLOWED EV_SERV NOT_ALLOWED DAQ NOT_ALLOWED STIM FIXED MULTICAST FIXED /end XCP_PACKET
  /end INITIAL_CMD_BUFFER
  /begin INITIAL_RES_ERR_BUFFER 0x02 MAX_FLX_LEN_BUF FIXED 32
   /begin LPDU_ID FLX_SLOT_ID FIXED 0x07C OFFSET FIXED 1 CYCLE_REPETITION FIXED 1 CHANNEL FIXED A /end LPDU_ID
   /begin XCP_PACKET CMD NOT_ALLOWED RES_ERR FIXED EV_SERV FIXED DAQ FIXED STIM NOT_ALLOWED /end XCP_PACKET
  /end INITIAL_RES_ERR_BUFFER
  /begin POOL_BUFFER 0x03 MAX_FLX_LEN_BUF FIXED 32
   /begin LPDU_ID FLX_SLOT_ID VARIABLE INITIAL_VALUE 0x07D OFFSET FIXED 0 CYCLE_REPETITION FIXED 1 CHANNEL FIXED A /end LPDU_ID
   /begin XCP_PACKET CMD NOT_ALLOWED RES_ERR VARIABLE EV_SERV VARIABLE DAQ VARIABLE_INITIALISED STIM NOT_ALLOWED /end XCP_PACKET
  /end POOL_BUFFER
  /begin POOL_BUFFER 0x04 MAX_FLX_LEN_BUF VARIABLE 64
   /begin LPDU_ID FLX_SLOT_ID FIXED 0x07E OFFSET VARIABLE CYCLE_REPETITION VARIABLE CHANNEL FIXED A /end LPDU_ID
   /begin XCP_PACKET CMD VARIABLE RES_ERR VARIABLE EV_SERV VARIABLE DAQ VARIABLE STIM VARIABLE /end XCP_PACKET
  /end POOL_BUFFER
  /begin POOL_BUFFER 0x05 MAX_FLX_LEN_BUF VARIABLE 64
   /begin LPDU_ID FLX_SLOT_ID VARIABLE OFFSET VARIABLE CYCLE_REPETITION VARIABLE CHANNEL VARIABLE /end LPDU_ID
   /begin XCP_PACKET CMD VARIABLE RES_ERR VARIABLE EV_SERV VARIABLE DAQ VARIABLE STIM VARIABLE MULTICAST VARIABLE /end XCP_PACKET
  /end POOL_BUFFER
  OPTIONAL_TL_SUBCMD FLX_ASSIGN OPTIONAL_TL_SUBCMD FLX_ACTIVATE OPTIONAL_TL_SUBCMD FLX_DEACTIVATE OPTIONAL_TL_SUBCMD GET_DAQ_FLX_BUF OPTIONAL_TL_SUBCMD SET_DAQ_FLX_BUF OPTIONAL_TL_SUBCMD GET_DAQ_CLOCK_MULTICAST TRANSPORT_LAYER_INSTANCE "flexray transport layer" /end XCP_ON_FLX
 /begin XCP_ON_SxI 0x0105 /* XCP on SxI version */ 25000 ASYNCH_FULL_DUPLEX_MODE PARITY_ODD TWO_STOP_BITS /begin FRAMING 0x9A /* SYNC */ 0x9B /* ESC */ /end FRAMING HEADER_LEN_CTR_WORD NO_CHECKSUM /end XCP_ON_SxI
 /begin XCP_ON_USB 0x0105 /* XCP on USB version */ 0x108C /* Vendor ID is 0x108C */ 0x0EDC /* Product ID is 0x0EDC */ 0x02 /* Number of interface is 2 */ HEADER_LEN_FILL_WORD /* OUT-EP for CMD and */ /* STIM (additional USB Endpoints may also be specified) */
  /begin OUT_EP_CMD_STIM 0x01 /* Endpoint number is 1 (dir=OUT) */ BULK_TRANSFER 0x40 0 MESSAGE_PACKING_SINGLE ALIGNMENT_32_BIT /end OUT_EP_CMD_STIM
  /* IN-EP for RES/ERR, */ /* DAQ (additional USB Endpoints may also be specified) */ /* and EV/SERV (if not specified otherwise) */
  /begin IN_EP_RESERR_DAQ_EVSERV 0x01 /* Endpoint number is 1 (dir=IN) */ BULK_TRANSFER 0x40 0 MESSAGE_PACKING_SINGLE ALIGNMENT_32_BIT RECOMMENDED_HOST_BUFSIZE 1 /* Host: 1 * 64 bytes = 64 bytes */ /end IN_EP_RESERR_DAQ_EVSERV
  ALTERNATE_SETTING_NO 0x01 /* Use alternate setting number 1 */ /* of XCP interface */ /* Identification for assignment */ /* description file */ INTERFACE_STRING_DESCRIPTOR "XCP Master ECU on interface 1"
  /begin OUT_EP_ONLY_STIM /* Endpoint supporting packet type */ /* only STIM */ 0x02 /* Endpoint number is 2 (dir=OUT) */ BULK_TRANSFER 0x40 0 /* Polling interval do nt care */ /* Multiple XCP Messages/packet */ MESSAGE_PACKING_MULTIPLE ALIGNMENT_32_BIT /* XCP Messages start on 32 bit */ /end OUT_EP_ONLY_STIM
  /begin IN_EP_ONLY_DAQ /* Endpoint supporting packet type */ /* only DAQ */ 0x02 /* Endpoint number is 2 (dir=IN) */ BULK_TRANSFER 0x40 0 /* Streaming mode */ MESSAGE_PACKING_STREAMING ALIGNMENT_32_BIT /* XCP Messages start on 32 bit */ RECOMMENDED_HOST_BUFSIZE 5 /* Host: 5 * 64 bytes = 320 bytes */ /end IN_EP_ONLY_DAQ
  /begin IN_EP_ONLY_EVSERV /* Endpoint supporting packet types */ /* only EV, SERV */ 0x03 /* Endpoint number is 3 (dir=IN) */ INTERRUPT_TRANSFER 0x40 0x10 /* Polling interval is 16 ms */ MESSAGE_PACKING_SINGLE ALIGNMENT_32_BIT RECOMMENDED_HOST_BUFSIZE 1 /* Host: 1 * 64 bytes = 64 bytes */ /end IN_EP_ONLY_EVSERV
  /begin DAQ_LIST_USB_ENDPOINT 0x0000 /* DTO-DAQ dedicated to list 0 */ FIXED_IN 0x02 /* uses Endpoint 2 IN */ /end DAQ_LIST_USB_ENDPOINT
  /begin DAQ_LIST_USB_ENDPOINT 0x0001 /* DTO-DAQ dedicated to list 1 */ FIXED_IN 0x02 /* uses Endpoint 2 IN */ /end DAQ_LIST_USB_ENDPOINT
  /begin DAQ_LIST_USB_ENDPOINT 0x0002 /* DTO-STIM dedicated to list 2 */ FIXED_OUT 0x02 /* uses Endpoint 2 OUT */ /end DAQ_LIST_USB_ENDPOINT
 /end XCP_ON_USB
/end IF_DATA
